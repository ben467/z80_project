#define EEPROM_D0 4
#define EEPROM_D7 11
#define MAX_SIZE 256

int BUS_AK = 2;
byte data = 0;
byte dat_arr[] = { 0x3e, 0x55, 0xd3, 0x01, 0xff, 0xff };
/*
byte in_arr[] = {0x32, 0x00, 0x80, 0xfe, 0x32, 0xca, 0x0d, 0x80, 0x3e, 0x58, 0xd3, 0x01, 0xc7, 0x3e, 0x59, 0xd3, 0x01, 0xd3, 0x03, 0x76, 0xff, 0xff, 0xff, 0xff};
*/
/*
byte in_arr[] = { 0x52, 0x00, 0x00, 0x00, 0x3e, 0x41, 0xd3, 0x01, 0xdb, 0x02, 0x3e, 0x42, 0xfe, 0x42, 0xca, 0x00, 0x80, 0x00, 0x76, 0xff, 0xff, 0xff, 0x00, 0x52, 0x42 };
*/

byte in_arr[MAX_SIZE] = { 0x55, 0x3e, 0x51, 0xd3, 0x01, 0x21, 0x1a, 0xc3, 0x00, 0x80, 0x80, 0x7e, 0xfe,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 0x00, 0x52};

/*
byte in_arr[MAX_SIZE] = { 0x55, 0x3e, 0x43, 0xd3, 0x01, 0x31, 0xf0, 0x80, 0xcd, 0x14, 0x80, 0xd3, 0x01, 0xfe, 0x44, 0xcc, 0x1c, 0x80, 0xc3, 0x03, 0x80, 0xdb, 0x02, 0xfe, 
                          0x00, 0xc0, 0xc3, 0x14, 0x80, 0x3e, 0x44, 0xd3, 0x01, 0xcd, 0x70, 0x80, 0xdb, 0x02, 0xcd, 0x55, 0x80, 0x4f, 0xdb, 0x02, 0xcd, 0x55, 0x80, 0x47, 
                          0xcd, 0x70, 0x80, 0xdb, 0x02, 0xcd, 0x55, 0x80, 0x6f, 0xdb, 0x02, 0xcd, 0x55, 0x80, 0x67, 0x0a, 0xcd, 0x55, 0x80, 0xcd, 0x70, 0x80, 0x79, 0xbd, 
                          0xca, 0x4e, 0x80, 0x03, 0xc3, 0x3e, 0x80, 0x78, 0xbc, 0xc8, 0x03, 0xc3, 0x3e, 0x80, 0xc5, 0xf5, 0x47, 0xcb, 0x3f, 0xcb, 0x3f, 0xcb, 0x3f, 0xcb, 
                          0x3f, 0xcd, 0x75, 0x80, 0xd3, 0x01, 0x78, 0xe6, 0x0f, 0xcd, 0x75, 0x80, 0xd3, 0x01, 0xf1, 0xc1, 0xc9, 0x3e, 0x20, 0xd3, 0x01, 0xc9, 0xe5, 0xd5,
                          0x16, 0x00, 0x5f, 0x21, 0x92, 0x80, 0x19, 0x7e, 0xd1, 0xe1, 0xc9, 0x30, 0x31, 0x32, 0x33, 0x34, 0x35, 0x36, 0x37, 0x38, 0x39, 0x41, 0x42, 0x43, 
                          0x44, 0x45, 0x46, 0xff, 0xff, 0xff, 0x00, 0x52, 0x44, 0x44, 0x63 };
                          */
int k = 0;
int i = 0;
byte d = 0;
int max_num = 0;
void write_bus(byte dat1)
{
  Serial.print("OUT: ");
  Serial.println(dat1, HEX);
  //Serial.println(data);
  for (int pin = EEPROM_D0; pin <= EEPROM_D7; pin += 1) {
    pinMode(pin, OUTPUT);
  }
  for (int pin = EEPROM_D0; pin <= EEPROM_D7; pin += 1) {
    digitalWrite(pin, dat1 & 1);

    dat1 = dat1 >> 1;
  }
}
void outputISR()
{

  //digitalWrite(13, HIGH);
  //Serial.print("OUT");
  //data = 0xD8;


  if (data > 0)
  {
    Serial.println(data, HEX);
  }

  /*
  else
  {
    data = dat_arr[i];
    i++;
    //Serial.println(data, HEX);
    if (i == sizeof(dat_arr))
    {
      i = 0;
    }
  }*/
  if (data == 'U' || data == 'R' || data == 'B')
  {
    write_bus(data);
    data = 0;
    
  }
  else
  {
    d = in_arr[k];
    write_bus(d);
    k++;
  }
  
  if (k > sizeof(in_arr))
  {
    k = 0;
  }


  while (!digitalRead(BUS_AK))
  {

  }
  //delay(300);
  //digitalWrite(13, LOW);
  /*
  for (int pin = EEPROM_D0; pin <= EEPROM_D7; pin += 1) {
    digitalWrite(pin, 0);

  }*/
}
void input()
{
  //Serial.println("INPUT");
  char cc = 0;
  for (int pin = EEPROM_D0; pin <= EEPROM_D7; pin += 1) {
    pinMode(pin, INPUT);
  }
  for (int pin = EEPROM_D7; pin >= EEPROM_D0; pin -= 1) {
    cc = (cc << 1) + digitalRead(pin);
  }
  Serial.print(cc);
  //delay(500);
}
void endISR()
{
  for (int pin = EEPROM_D0; pin <= EEPROM_D7; pin += 1) {
    pinMode(pin, INPUT);
  }

  //Serial.println("Bus disconnected");
}
void setup() {
  // put your setup code here, to run once:
  Serial.begin(9600);
  //pinMode(13, OUTPUT);
  endISR();
  Serial.println("out");
  pinMode(BUS_AK, INPUT);
  pinMode(3, INPUT);
  attachInterrupt(digitalPinToInterrupt(BUS_AK), outputISR, FALLING);
  attachInterrupt(digitalPinToInterrupt(3), input, FALLING);
  //attachInterrupt(digitalPinToInterrupt(BUS_AK), endISR, RISING);
  Serial.println(sizeof(in_arr));

  while (in_arr[max_num] != 0x32)
  {
    max_num++;
  }
  Serial.println(max_num);

}

void loop() {
  // put your main code here, to run repeatedly:
  endISR();
  if (Serial.available() > 0)
  {
    max_num++;
    in_arr[max_num] = Serial.read();
    Serial.println(max_num);
  }
  
  /*
  if (Serial.available())
  {
    data = Serial.read();
  }*/

}
